## Kconfig
```kconfig
#  This file is part of DirectFB-examples.
#
#  Permission is hereby granted, free of charge, to any person obtaining a copy
#  of this software and associated documentation files (the "Software"), to deal
#  in the Software without restriction, including without limitation the rights
#  to use, copy, modify, merge, publish, distribute, sublicense, and/or sell
#  copies of the Software, and to permit persons to whom the Software is
#  furnished to do so, subject to the following conditions:
#
#  The above copyright notice and this permission notice shall be included in
#  all copies or substantial portions of the Software.
#
#  THE SOFTWARE IS PROVIDED "AS IS", WITHOUT WARRANTY OF ANY KIND, EXPRESS OR
#  IMPLIED, INCLUDING BUT NOT LIMITED TO THE WARRANTIES OF MERCHANTABILITY,
#  FITNESS FOR A PARTICULAR PURPOSE AND NONINFRINGEMENT. IN NO EVENT SHALL THE
#  AUTHORS OR COPYRIGHT HOLDERS BE LIABLE FOR ANY CLAIM, DAMAGES OR OTHER
#  LIABILITY, WHETHER IN AN ACTION OF CONTRACT, TORT OR OTHERWISE, ARISING FROM,
#  OUT OF OR IN CONNECTION WITH THE SOFTWARE OR THE USE OR OTHER DEALINGS IN
#  THE SOFTWARE.

config EXAMPLES_DIRECTFB
	tristate "DirectFB examples"
	default n
	depends on GRAPHICS_DIRECTFB2
	---help---
		Enable DirectFB examples.

if EXAMPLES_DIRECTFB

choice
	prompt "Example selection"
	default DF_ANDI

config DF_ANDI
	bool "df_andi"

config DF_DOK
	bool "df_dok"

config DF_FIRE
	bool "df_fire"

config DF_KNUCKLES
	bool "df_knuckles"

config DF_MATRIX
	bool "df_matrix"

config DF_NEO
	bool "df_neo"

config DF_PARTICLE
	bool "df_particle"

config DF_TEXTURE
	bool "df_texture"

config DF_VIDEO
	bool "df_video"

config DF_WINDOW
	bool "df_window"

endchoice

endif
```
